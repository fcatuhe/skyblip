## CMakeLists.txt
```
cmake_minimum_required(VERSION 3.20.0)

find_package(Zephyr REQUIRED HINTS $ENV{ZEPHYR_BASE})
project(platform_adapters LANGUAGES C CXX)

set(FIRMWARE ${CMAKE_CURRENT_SOURCE_DIR}/../../..)
target_include_directories(app PRIVATE ${FIRMWARE})
target_sources(app PRIVATE src/main.cpp src/rf.cpp
  ${FIRMWARE}/hardware/parts/sx1262/sx1262.cpp
  ${FIRMWARE}/core/timing/channel.cpp)
```

## prj.conf
```kconfig
CONFIG_ZTEST=y
CONFIG_CPP=y
CONFIG_STD_CPP20=y
CONFIG_CPP_EXCEPTIONS=n
# The radio executor and the SX1262 model are written against the host standard library here.
CONFIG_EXTERNAL_LIBCPP=y
CONFIG_NVS=y
CONFIG_FLASH=y
CONFIG_FLASH_MAP=y
CONFIG_FLASH_PAGE_LAYOUT=y
# native_sim has no flash: the simulator provides the storage_partition the
# adapter mounts NVS on, which is the whole point of running it here.
CONFIG_FLASH_SIMULATOR=y
CONFIG_FLASH_SIMULATOR_STATS=n
# The radio executor arms its DIO1 wake on the emulated GPIO app.overlay names.
CONFIG_GPIO=y
```

## app.overlay
```dts
/* The SX1262's DIO1, which the radio executor arms for its wakes, on the emulated GPIO. */
/ {
	board_part_gpios {
		compatible = "gpio-keys";
		status = "disabled";

		radio_dio1_gpio: radio_dio1 {
			gpios = <&gpio0 0 GPIO_ACTIVE_HIGH>;
		};
	};
};
```

## src/main.cpp
```c
// What the pure-host suite cannot reach: the Zephyr-backed adapters themselves.
// Runs under native_sim in CI and on the board when one is attached.
#include <zephyr/ztest.h>

#include "hardware/platform/zephyr/io.h"
#include "hardware/platform/zephyr/kvstore.h"

using namespace skyblip;

ZTEST_SUITE(platform_adapters, NULL, NULL, NULL, NULL, NULL);

ZTEST(platform_adapters, test_kvstore_round_trips_through_nvs) {
    platform::zephyr::KeyValueStore key_value;
    zassert_equal(key_value.begin(), Status::Ok, "NVS did not come up");

    const uint8_t written[] = {1, 2, 3, 4};
    zassert_equal(key_value.write("settings", written, sizeof(written)), Status::Ok);

    uint8_t read[8] = {0};
    size_t stored_bytes = 0;
    zassert_equal(key_value.read("settings", read, sizeof(read), stored_bytes), Status::Ok);
    zassert_equal(stored_bytes, sizeof(written));
    zassert_mem_equal(read, written, sizeof(written));
}

// NVS never reads sector 2 of an otherwise clean store, so only the check can erase a ring page
// there.
ZTEST(platform_adapters, test_kvstore_erases_a_meshtastic_ring_before_mounting) {
    const struct device* flash = PARTITION_DEVICE(storage_partition);
    const off_t start = PARTITION_OFFSET(storage_partition);
    struct flash_pages_info page;
    zassert_equal(flash_get_page_info_by_offs(flash, start, &page), 0);
    zassert_equal(flash_flatten(flash, start, 3 * page.size), 0);
    const off_t ring_page = start + static_cast<off_t>(2 * page.size);
    const uint32_t header[2] = {platform::kWarmRingMagicV3, 7};
    zassert_equal(flash_write(flash, ring_page, header, sizeof(header)), 0);

    platform::zephyr::KeyValueStore key_value;
    zassert_equal(key_value.begin(), Status::Ok, "NVS did not come up over the ring");
    uint32_t first_word = 0;
    zassert_equal(flash_read(flash, ring_page, &first_word, sizeof(first_word)), 0);
    zassert_not_equal(first_word, platform::kWarmRingMagicV3, "the ring page survived");

    const uint8_t written[] = {1, 2, 3, 4};
    zassert_equal(key_value.write("settings", written, sizeof(written)), Status::Ok);
    uint8_t read[8] = {0};
    size_t stored_bytes = 0;
    zassert_equal(key_value.read("settings", read, sizeof(read), stored_bytes), Status::Ok);
    zassert_mem_equal(read, written, sizeof(written));
}

ZTEST(platform_adapters, test_missing_key_is_not_found) {
    platform::zephyr::KeyValueStore key_value;
    zassert_equal(key_value.begin(), Status::Ok);
    uint8_t read[4] = {0};
    size_t stored_bytes = 0;
    zassert_equal(key_value.read("nope", read, sizeof(read), stored_bytes), Status::NotFound);
}

namespace {

uint32_t waited_us(platform::zephyr::Delay& delay, uint32_t hold_us) {
    const uint32_t started_cycles = k_cycle_get_32();
    delay.wait_at_least_us(hold_us);
    return k_cyc_to_us_floor32(k_cycle_get_32() - started_cycles);
}

}  // namespace

ZTEST(platform_adapters, test_delay_sleeps_at_least_the_datasheet_windows) {
    platform::zephyr::Delay delay;
    const uint32_t windows_us[] = {10, 100, 500, 10000};
    for (const uint32_t window_us : windows_us)
        zassert_true(waited_us(delay, window_us) >= window_us, "asked for %u us", window_us);
}

ZTEST(platform_adapters, test_delay_with_interrupts_locked_spins_the_whole_window) {
    platform::zephyr::Delay delay;
    const unsigned int key = irq_lock();
    const uint32_t waited = waited_us(delay, 500);
    irq_unlock(key);
    zassert_true(waited >= 500, "waited %u us", waited);
}
```

## src/rf.cpp
```c
#include "hardware/platform/zephyr/rf.h"

#include <zephyr/ztest.h>

#include "core/bus/bus.h"
#include "hardware/parts/sx1262/model.h"
#include "hardware/parts/sx1262/sx1262.h"
#include "hardware/platform/zephyr/clock.h"

using namespace skyblip;

namespace {

class PendingSx1262 : public models::Sx1262 {
   public:
    bool transfer(const uint8_t* tx, uint8_t* rx, size_t bytes) override {
        const bool moved = models::Sx1262::transfer(tx, rx, bytes);
        if (!pend_on_stage_ || commands_seen.empty() ||
            commands_seen.back() != parts::sx1262::kWriteBuffer)
            return moved;
        pend_on_stage_ = false;
        k_sem_give(&staging_);
        (void)k_sem_take(&resume_, K_FOREVER);
        return moved;
    }

    void pend_on_next_stage() {
        k_sem_init(&staging_, 0, 1);
        k_sem_init(&resume_, 0, 1);
        pend_on_stage_ = true;
    }

    int wait_staging(k_timeout_t timeout) { return k_sem_take(&staging_, timeout); }
    void resume() { k_sem_give(&resume_); }

   private:
    volatile bool pend_on_stage_{false};
    struct k_sem staging_{};
    struct k_sem resume_{};
};

PendingSx1262 chip;
parts::Sx1262 radio(chip, chip, chip, chip.busy_pin, chip.reset_pin, chip.dio1_pin);
platform::zephyr::Clock uptime;
bus::RfQueue reported;
platform::zephyr::Rf rf(radio, uptime, reported);
const uint8_t burst[24] = {0};

}  // namespace

ZTEST_SUITE(rf_executor, NULL, NULL, NULL, NULL, NULL);

// The power-off park can land while staging pends the radio thread on the SPI, as nrfx SPIM does.
ZTEST(rf_executor, test_a_park_during_staging_keys_no_burst) {
    zassert_equal(rf.begin(), Status::Ok, "the radio did not come up");
    chip.pend_on_next_stage();

    const uint64_t now_us = uptime.microseconds();
    ports::RfPlan plan{};
    plan.mode = ports::RfMode::RxMBand;
    plan.start_us = now_us + 20000;
    plan.end_us = plan.start_us + 30000;
    plan.tx = burst;
    plan.tx_bytes = sizeof(burst);
    plan.tx_at_us = plan.start_us + 10000;
    plan.tx_forced = true;
    zassert_equal(rf.arm(plan), Status::Ok);

    zassert_equal(chip.wait_staging(K_MSEC(1000)), 0, "the burst was never staged");
    rf.sleep();
    chip.resume();
    for (int waited_ms = 0; !rf.parked() && waited_ms < 1000; waited_ms++) k_msleep(1);

    zassert_true(rf.parked(), "the radio thread never parked");
    zassert_false(chip.saw_command(parts::sx1262::kSetTx), "a burst keyed after the park");
    int missed = 0;
    for (events::RfEvent event{}; reported.pop(event);) {
        zassert_equal(event.type, events::RfEventType::Missed);
        zassert_equal(event.tx_at_us, plan.tx_at_us);
        zassert_equal(event.keyed_at_us, 0u);
        missed++;
    }
    zassert_equal(missed, 1, "the burst was not reported Missed once");
}
```
