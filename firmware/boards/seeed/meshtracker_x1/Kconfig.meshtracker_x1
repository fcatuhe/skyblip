## firmware/boards/seeed/meshtracker_x1/board.yml
```yaml
board:
  name: meshtracker_x1
  full_name: Seeed SenseCAP MeshTracker X1 (skyBlip Bravo)
  vendor: seeed
  socs:
    - name: nrf52840
```

## firmware/products/skyblip_go/Kconfig.sysbuild
```kconfig
source "share/sysbuild/Kconfig"

config SKYBLIP_IMU_IMAGE_LINKED
	bool "Build the full image, which carries the BHI260AP image"
	default y
```

## firmware/test/twister/smp_gate/testcase.yaml
```yaml
tests:
  platform.smp_gate:
    tags: platform mcumgr dfu
    platform_allow:
      - native_sim
```

## firmware/zephyr/Kconfig
```kconfig
config SKYBLIP_ACTIVATION
	bool "Activate the unit against skyblip.eu"
	help
	  The unit keeps a key of its own in UICR, provisioned before Bluetooth
	  starts, and trusts the server key compiled in from keys/server.pub. A
	  product without it provisions no key and embeds no server key. The
	  MCUboot signing keys are sysbuild's and every product keeps them.

config SKYBLIP_IMU_IMAGE
	bool "Pin the BHI260AP image the sensor hub boots"
	help
	  The build hashes the hub's firmware into the image, so the update page
	  and the hub's flash copy both know which one it was built against.

config SKYBLIP_IMU_IMAGE_LINKED
	bool "Carry the BHI260AP image in the application"
	depends on SKYBLIP_IMU_IMAGE
	default y
	help
	  A full image links the sensor hub's firmware, boots the hub from it and
	  keeps a copy on imu_image_partition. Without it, a slim image boots the
	  hub from that copy and is 101 KB lighter over the air.
```
