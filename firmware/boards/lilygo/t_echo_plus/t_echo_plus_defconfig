## firmware/zephyr/Kconfig
```kconfig
config SKYBLIP_ACTIVATION
	bool "Activate the unit against skyblip.eu"
	help
	  The unit keeps a key of its own in UICR, provisioned before Bluetooth
	  starts, and trusts the server key compiled in from keys/server.pub. A
	  product without it provisions no key and embeds no server key. The
	  MCUboot signing keys are sysbuild's and every product keeps them.

config SKYBLIP_IMU_IMAGE
	bool "Pin the BHI260AP image the sensor hub boots"
	help
	  The build hashes the hub's firmware into the image, so the update page
	  and the hub's flash copy both know which one it was built against.

config SKYBLIP_IMU_IMAGE_LINKED
	bool "Carry the BHI260AP image in the application"
	depends on SKYBLIP_IMU_IMAGE
	default y
	help
	  A full image links the sensor hub's firmware, boots the hub from it and
	  keeps a copy on imu_image_partition. Without it, a base image boots the
	  hub from that copy and is 101 KB lighter over the air.

config SKYBLIP_PEER_SERVER
	bool "Serve the peer endpoint to a paired Go"
	help
	  Bravo serves the peer characteristic its paired Go writes peer_claim
	  to and reads observation and health from. The Go reaches Bravo's as
	  a central and serves none.

# TODO: fc 13nov26 adsb trial #293, remove once the trial picks the LR2021 settings
config SKYBLIP_BRAVO_ADSB_TRIAL
	bool "Answer adsb_trial, the temporary reception trial of #293"
	help
	  A development Bravo compares the LR2021's 1090 MHz settings slot by
	  slot (products/skyblip_bravo/services/adsb_trial.md). A release
	  image answers the command unknown_command.
```
